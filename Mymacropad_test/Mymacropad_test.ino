#include <Keyboard.h>
#include <SPI.h>
#include <Adafruit_GFX.h>
#include <Arduino_ST7789_Fast.h>
#include <Adafruit_NeoPixel.h>

// Color definitions
#define BLACK           0x0000
#define BLUE            0x001F
#define RED             0xF800
#define GREEN           0x07E0
#define CYAN            0x07FF
#define MAGENTA         0xF81F
#define YELLOW          0xFFE0
#define WHITE           0xFFFF
// Color definitions

// Display
#define TFT_DC     19  // define data/command pin
#define TFT_RST    18  // define reset pin, or set to -1 and connect to Arduino RESET pin
#define SCR_WD   240
#define SCR_HT   240   // 320 - to allow access to full 240x320 frame buffer
// Display

#define bitmap_height   240
#define bitmap_width    240

//Buttons
#define LUp 4 
#define Up 5
#define RUp 6
#define Left 7
#define Down 8
#define Right 9
#define LedData 10 
#define NumLed 6
#define Switch 21 // Pin A3
boolean OledClear = true;
//Buttons

Arduino_ST7789 lcd = Arduino_ST7789(TFT_DC, TFT_RST);
//Arduino_ST7789 lcd = Arduino_ST7789(TFT_DC, TFT_RST, TFT_CS);
Adafruit_NeoPixel strip = Adafruit_NeoPixel(NumLed, LedData, NEO_GRB + NEO_KHZ800);

static const unsigned char PROGMEM bitmap[] =
{ 0x00, 0x00, 0x00, 0x00, 0x00, 0x00, 0x00, 0x00, 0x00, 0x00, 0x00, 0x00, 0x00, 0x00, 0x00, 0x00, 
	0x00, 0x00, 0x00, 0x00, 0x00, 0x00, 0x00, 0x00, 0x00, 0x00, 0x00, 0x00, 0x00, 0x00, 0x00, 0x00, 
	0x00, 0x00, 0x00, 0x00, 0x00, 0x00, 0x00, 0x00, 0x00, 0x00, 0x00, 0x00, 0x00, 0x00, 0x00, 0x00, 
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	0x00, 0x00, 0x00, 0x00, 0x00, 0x00, 0x00, 0x00, 0x00, 0x00, 0x00, 0x00, 0x00, 0x00, 0x00, 0x00
};

void setup() {
  // Telling the Arduino that the switches are inputs, and the Leds are output //
  pinMode (LUp, INPUT_PULLUP);
  pinMode (Up, INPUT_PULLUP);
  pinMode (RUp, INPUT_PULLUP);
  pinMode (Left, INPUT_PULLUP);
  pinMode (Down, INPUT_PULLUP);
  pinMode (Right, INPUT_PULLUP);
  pinMode (Switch, INPUT_PULLUP);
  pinMode (LedData, OUTPUT);
  //starting the strip
  strip.begin();
  strip.show();

  Keyboard.begin();
  
  lcd.begin();
  lcd.init(SCR_WD, SCR_HT);
  lcd.fillScreen(BLACK);
  lcd.setTextColor(WHITE,BLACK);
  lcd.setTextSize(4);
  

}

void loop() {
      //First Layer Programming// //First Layer Programming// //First Layer Programming// //First Layer Programming//
  if (digitalRead(Switch) == HIGH)
  {
        //Setting the colours (Led number, Red, Green, Blue) max amount that each RGB value can have is 255, min is 0//
    strip.setPixelColor(0, 0, 255, 255);
    strip.setPixelColor(1, 0, 255, 255);
    strip.setPixelColor(2, 0, 255, 255);
    strip.setPixelColor(3, 255, 0, 128);
    strip.setPixelColor(4, 0, 255, 255);
    strip.setPixelColor(5, 255, 0, 128);
    strip.show();
    //Boolean Checks to make sure that we haven't done this before//
    if (OledClear == true) {
      lcd.fillScreen(BLACK);
      lcd.drawBitmap(0, 0, bitmap, bitmap_height, bitmap_width, RED, WHITE); //
      delay(1000);
      OledClear = false;
    }
    //Up Arrow//
    if (digitalRead(Up) == LOW)
    {
      Keyboard.press(KEY_UP_ARROW);
    }
    if (digitalRead(Up) == HIGH)
    {
      Keyboard.release(KEY_UP_ARROW);
    }

    //Down Arrow//
    if (digitalRead(Down) == LOW)
    {
      Keyboard.press(KEY_DOWN_ARROW);
    }
    if (digitalRead(Down) == HIGH)
    {
      Keyboard.release(KEY_DOWN_ARROW);
    }

    //Right Arrow//
    if (digitalRead(Right) == LOW)
    {
      Keyboard.press(KEY_RIGHT_ARROW);
    }
    if (digitalRead(Right) == HIGH)
    {
      Keyboard.release(KEY_RIGHT_ARROW);
    }

    //Left Arrow//
    if (digitalRead(Left) == LOW)
    {
      Keyboard.press(KEY_LEFT_ARROW);
    }
    if (digitalRead(Left) == HIGH)
    {
      Keyboard.release(KEY_LEFT_ARROW);
    }

    //Top Right Button//
    if (digitalRead(RUp) == LOW)
    {
      Keyboard.press(KEY_LEFT_CTRL);
    }
    if (digitalRead(RUp)==HIGH)
    {
      Keyboard.release(KEY_LEFT_CTRL);
    }

    //Top Right Button//
    if (digitalRead(LUp) == LOW)
    {
      Keyboard.press(KEY_LEFT_ALT);
    }
    if (digitalRead(LUp) == HIGH)
    {
      Keyboard.release(KEY_LEFT_ALT);
    }
  }

  //Second Layer Programming// //Second Layer Programming// //Second Layer Programming// //Second Layer Programming// //Second Layer Programmed//

  else if (digitalRead(Switch) == LOW)
  {
    //Setting the colours (Led number, Red, Green, Blue) max amount that each RGB value can have is 255, min is 0//
    strip.setPixelColor(0, 255, 0, 255);
    strip.setPixelColor(1, 255, 0, 255);
    strip.setPixelColor(2, 255, 0, 255);
    strip.setPixelColor(3, 255, 255, 255);
    strip.setPixelColor(4, 255, 0, 255);
    strip.setPixelColor(5, 255, 255, 255);
    strip.show();

    //Make sure that we aren't constantly clearing the display//
    if (OledClear == false)
    {
      lcd.init(SCR_WD, SCR_HT);
      lcd.fillScreen(BLACK);
      lcd.setCursor(0, 0);
      lcd.setTextColor(WHITE,BLUE);
      lcd.setTextSize(3);
      lcd.println("Layer 2");
      OledClear = true;
    }
    //Up Arrow//
    if (digitalRead(Up) == LOW)
    {
      Keyboard.press(KEY_UP_ARROW);
    }
    if (digitalRead(Up) == HIGH)
    {
      Keyboard.release(KEY_UP_ARROW);
    }

    //Down Arrow//
    if (digitalRead(Down) == LOW)
    {
      Keyboard.press(KEY_DOWN_ARROW);
    }
    if (digitalRead(Down) == HIGH)
    {
      Keyboard.release(KEY_DOWN_ARROW);
    }

    //Right Arrow//
    if (digitalRead(Right) == LOW)
    {
      Keyboard.press(KEY_RIGHT_ARROW);
    }
    if (digitalRead(Right) == HIGH)
    {
      Keyboard.release(KEY_RIGHT_ARROW);
    }

    //Left Arrow//
    if (digitalRead(Left) == LOW)
    {
      Keyboard.press(KEY_LEFT_ARROW);
    }
    if (digitalRead(Left) == HIGH)
    {
      Keyboard.release(KEY_LEFT_ARROW);
    }

    //Top Right Button//
    if (digitalRead(RUp) == LOW)
    {
      Keyboard.press(KEY_LEFT_CTRL);
    }
    if (digitalRead(RUp)==HIGH)
    {
      Keyboard.release(KEY_LEFT_CTRL);
    }

    //Top Right Button//
    if (digitalRead(LUp) == LOW)
    {
      Keyboard.press(KEY_LEFT_ALT);
    }
    if (digitalRead(LUp) == HIGH)
    {
      Keyboard.release(KEY_LEFT_ALT);
    }
  }
}